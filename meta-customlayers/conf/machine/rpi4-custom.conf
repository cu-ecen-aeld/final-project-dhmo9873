## meta-customlayers/conf/machine/rpi4-custom.conf
```bitbake
# Inherit everything from the base Raspberry Pi 4 configuration
require conf/machine/raspberrypi4-64.conf

# Apply your specific hardware overrides
ARM_KEEP_ALBI = "1"
ENABLE_UART = "1"
MACHINE_FEATURES += "vc4graphics"
RPI_USE_U_BOOT = "1"

RPI_EXTRA_CONFIG = " \
    dtparam=i2c_arm=on \n \
    dtparam=i2c_vc=on \n \
    dtoverlay=imx219 \n \
    dtoverlay=ism330dhcx-overlay \\n \
"
LICENSE_FLAGS_ACCEPTED += "synaptics-killswitch"
# Force the kernel to load the user-space I2C driver on boot
KERNEL_MODULE_AUTOLOAD += "i2c-dev"
IMAGE_BOOT_FILES:append = " ism330dhcx-overlay.dtbo;overlays/ism330dhcx-overlay.dtbo"
```
